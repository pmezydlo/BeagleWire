/*
* Copyright (C) 2018 Patryk Mezydlo <mezydlo.p@gmail.com>
*
* This program is free software; you can redistribute it and/or modify
* it under the terms of the GNU General Public License version 2 as
* published by the Free Software Foundation.
*/
/dts-v1/;
/plugin/;

/ {
	compatible = "ti,beaglebone", "ti,beaglebone-black";

	/* Identification */
	part-number = "BW-GPIO-ICE40Cape";
	version = "00A0";

	fragment@0 {
		target = <&ocp>;
		__overlay__ {
			gpio-ice40 {
                                compatible = "linux,gpio-mmio";
				reg = <0x1000000 0x8>, <0x1000008 0x8>, <0x01000010 0x8>;
				reg-names = "dirout", "dat", "set"; 
				#gpio-cells = <2>;
				gpio-controller;
			};
		};
	};
};
